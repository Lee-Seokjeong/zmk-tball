## config/west.yml
```yaml
manifest:
  remotes:
    - name: cdc-mkb
      url-base: https://github.com/cdc-mkb
    - name: Lee-Seokjeong
      url-base: https://github.com/Lee-Seokjeong
    # Additional modules containing boards/shields/custom code can be listed here as well
    # See https://docs.zephyrproject.org/3.2.0/develop/west/manifest.html#projects
  projects:
    - name: zmk-tball
      remote: Lee-Seokjeong
      revision: master
      
    - name: zmk
      remote: cdc-mkb
      revision: mouse-pim447
      import: app/west.yml
  self:
    path: config
```
